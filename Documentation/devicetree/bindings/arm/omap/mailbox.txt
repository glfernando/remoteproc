## Documentation/devicetree/bindings/arm/omap/mailbox.txt
```
OMAP Mailbox module

Required properties:
 compatible : should be "ti,omap2-mailbox" for OMAP2 mailbox
 compatible : should be "ti,omap3-mailbox" for OMAP3 mailbox
 compatible : should be "ti,omap4-mailbox" for OMAP4 mailbox

Optional properties:
 None
```
